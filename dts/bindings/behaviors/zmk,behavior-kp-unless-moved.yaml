## dts/bindings/behaviors/zmk,behavior-kp-unless-moved.yaml
```yaml
# SPDX-License-Identifier: GPL-2.0-or-later
# copyright (C) 2026 knttnk

# ビヘイビアkp_unless_movedのノードに書ける設定項目を定義する。
# 実装はsrc/behavior_kp_unless_moved.cにある。

description: |
  Key press that sends nothing when the trackball has moved by the threshold
  or more while scrolling since the last layer activation.

# CソースのDT_DRV_COMPATに書いたzmk_behavior_kp_unless_movedと対応する。
compatible: "zmk,behavior-kp-unless-moved"

# ZMK本体にある、パラメータを1つ取るビヘイビア共通の定義を読み込む。
include: one_param.yaml

properties:
  # ボールの移動量の合計がこの値以上なら、キーを送らない。センサーの移動量で指定する。
  motion-threshold:
    type: int
    required: true
    description: Amount of trackball movement at or above which the key is not sent.
```

## dts/bindings/behaviors/zmk,behavior-momentary-layer-unlock.yaml
```yaml
# SPDX-License-Identifier: GPL-2.0-or-later
# copyright (C) 2026 knttnk

# ビヘイビアmo_unlockのノードに書ける設定項目を定義する。
# 実装はsrc/behavior_mo_unlock.cにある。

description: |
  Momentary layer that also deactivates the given layers when pressed.

# CソースのDT_DRV_COMPATに書いたzmk_behavior_momentary_layer_unlockと対応する。
compatible: "zmk,behavior-momentary-layer-unlock"

# ZMK本体にある、パラメータを1つ取るビヘイビア共通の定義を読み込む。
include: one_param.yaml

properties:
  # 押したときに無効にするレイヤーの番号。固定して使うレイヤーを書く。
  unlock-layers:
    type: array
    required: true
    description: Layers to deactivate when the behavior is pressed.
```

## dts/bindings/input_processors/zmk,input-processor-axis-accel.yaml
```yaml
# SPDX-License-Identifier: GPL-2.0-or-later
# copyright (C) 2026 knttnk

# 入力プロセッサzip_axis_accelのノードに書ける設定項目を定義する。
# 実装はsrc/input_processor_axis_accel.cにある。

description: |
  Input processor that makes the pointer speed proportional to
  (ball speed)^(5/4) per axis, by rewriting relative X/Y as
  value * |value|^(1/4) * scale.

# CソースのDT_DRV_COMPATに書いたzmk_input_processor_axis_accelと対応する。
compatible: "zmk,input-processor-axis-accel"

# ZMK本体にある、パラメータを取らない入力プロセッサ共通の定義を読み込む。
# track-remaindersもこの定義に含まれている。
include: ip_zero_param.yaml

properties:
  # 移動量が1のときのX方向の倍率。千分率で指定する。大きくするとポインタが速くなる。
  x-scale-permille:
    type: int
    required: true
    description: Gain for X at a movement of 1 count per report, in 1/1000.

  # 移動量が1のときのY方向の倍率。千分率で指定する。
  y-scale-permille:
    type: int
    required: true
    description: Gain for Y at a movement of 1 count per report, in 1/1000.
```

## dts/bindings/input_processors/zmk,input-processor-deadzone.yaml
```yaml
# SPDX-License-Identifier: GPL-2.0-or-later
# copyright (C) 2026 knttnk

# 入力プロセッサzip_hscroll_deadzoneのノードに書ける設定項目を定義する。
# 実装はsrc/input_processor_deadzone.cにある。

description: |
  Input processor that replaces values smaller than the threshold with 0
  for the given event codes. Values at or above the threshold pass unchanged.

# CソースのDT_DRV_COMPATに書いたzmk_input_processor_deadzoneと対応する。
compatible: "zmk,input-processor-deadzone"

# ZMK本体にある、パラメータを取らない入力プロセッサ共通の定義を読み込む。
include: ip_zero_param.yaml

properties:
  # 対象にする入力の種類。省略するとINPUT_EV_RELになる。
  type:
    type: int
    description: Input event type to filter. Defaults to INPUT_EV_REL.

  # 対象にする入力のコード。INPUT_REL_HWHEELなどを並べる。
  codes:
    type: array
    required: true
    description: Input event codes to filter.

  # 値の大きさがこの閾値に満たないとき、値を0にする。
  threshold:
    type: int
    required: true
    description: Values whose magnitude is below this threshold are replaced with 0.
```

## dts/bindings/input_processors/zmk,input-processor-motion-meter.yaml
```yaml
# SPDX-License-Identifier: GPL-2.0-or-later
# copyright (C) 2026 knttnk

# 入力プロセッサzip_motion_meterのノードの種類を定義する。設定項目はない。
# 実装はsrc/input_processor_motion_meter.cにある。

description: |
  Input processor that counts the amount of relative movement passing
  through it, without changing the events.

# CソースのDT_DRV_COMPATに書いたzmk_input_processor_motion_meterと対応する。
compatible: "zmk,input-processor-motion-meter"

# ZMK本体にある、パラメータを取らない入力プロセッサ共通の定義を読み込む。
include: ip_zero_param.yaml
```
